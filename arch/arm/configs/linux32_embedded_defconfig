## arch/mips/configs/linux32_embedded_defconfig
```kconfig
# MIPS 32-bit embedded defconfig — Linux32 fork (QEMU malta / router SoCs)
# copyright Koubba Mohamed Rayan — Chamesle-Certification-1.0
# Build: make ARCH=mips linux32_embedded_defconfig && make ARCH=mips -j$(nproc)

CONFIG_LOCALVERSION="-embedded"
# CONFIG_LOCALVERSION_AUTO is not set
CONFIG_LINUX32_EMBEDDED=y
CONFIG_SYSVIPC=y
CONFIG_NO_HZ_IDLE=y
CONFIG_HIGH_RES_TIMERS=y
CONFIG_LOG_BUF_SHIFT=14
CONFIG_CC_OPTIMIZE_FOR_SIZE=y
CONFIG_BLK_DEV_INITRD=y
CONFIG_EXPERT=y
CONFIG_MIPS_MALTA=y
CONFIG_CPU_LITTLE_ENDIAN=y
CONFIG_CPU_MIPS32_R2=y
CONFIG_HZ_100=y
CONFIG_CMA=y
CONFIG_CMA_SIZE_MBYTES=16
CONFIG_MODULES=y
CONFIG_MODULE_UNLOAD=y
CONFIG_NET=y
CONFIG_PACKET=y
CONFIG_UNIX=y
CONFIG_INET=y
CONFIG_IP_MULTICAST=y
CONFIG_IP_PNP=y
CONFIG_IP_PNP_DHCP=y
# CONFIG_INET_DIAG is not set
CONFIG_MTD=y
CONFIG_MTD_CMDLINE_PARTS=y
CONFIG_MTD_BLOCK=y
CONFIG_MTD_SPI_NOR=y
CONFIG_BLK_DEV_RAM=y
CONFIG_BLK_DEV_RAM_SIZE=8192
CONFIG_NETDEVICES=y
CONFIG_DEVTMPFS=y
CONFIG_DEVTMPFS_MOUNT=y
CONFIG_SERIAL_8250=y
CONFIG_SERIAL_8250_CONSOLE=y
CONFIG_SERIAL_8250_RUNTIME_UARTS=2
CONFIG_SPI=y
CONFIG_GPIOLIB=y
CONFIG_WATCHDOG=y
CONFIG_WATCHDOG_CORE=y
CONFIG_RTC_CLASS=y
CONFIG_EXT4_FS=y
CONFIG_SQUASHFS=y
CONFIG_SQUASHFS_XZ=y
CONFIG_TMPFS=y
CONFIG_JFFS2_FS=y
CONFIG_UBIFS_FS=y
CONFIG_NFS_FS=y
CONFIG_ROOT_NFS=y
CONFIG_PRINTK_TIME=y
CONFIG_MAGIC_SYSRQ=y
```

## arch/x86/configs/i386_embedded_defconfig
```kconfig
# i386 embedded defconfig — Linux32 fork
# copyright Koubba Mohamed Rayan — Chamesle-Certification-1.0
#
# Target: 32-bit x86 embedded/industrial boards (Geode, Vortex86, etc.)
# Build:  make ARCH=i386 i386_embedded_defconfig && make ARCH=i386 -j$(nproc)

CONFIG_WERROR=y
CONFIG_LOCALVERSION="-embedded"
# CONFIG_LOCALVERSION_AUTO is not set
CONFIG_LINUX32_EMBEDDED=y
CONFIG_SYSVIPC=y
CONFIG_NO_HZ_IDLE=y
CONFIG_HIGH_RES_TIMERS=y
CONFIG_PREEMPT_VOLUNTARY=y
CONFIG_LOG_BUF_SHIFT=14
CONFIG_BLK_DEV_INITRD=y
# CONFIG_64BIT is not set
# CONFIG_SMP is not set
CONFIG_HZ_100=y
CONFIG_CMA=y
CONFIG_CMA_SIZE_MBYTES=16
CONFIG_MODULES=y
CONFIG_MODULE_UNLOAD=y
# CONFIG_AUDIT is not set
# CONFIG_KEXEC is not set
CONFIG_X86_MSR=y
CONFIG_X86_CPUID=y
# CONFIG_EFI is not set
# CONFIG_HIBERNATION is not set
CONFIG_CPU_FREQ=y
CONFIG_CPU_FREQ_DEFAULT_GOV_ONDEMAND=y
CONFIG_X86_ACPI_CPUFREQ=y
CONFIG_BINFMT_MISC=y
CONFIG_NET=y
CONFIG_PACKET=y
CONFIG_UNIX=y
CONFIG_INET=y
CONFIG_IP_MULTICAST=y
CONFIG_IP_PNP=y
CONFIG_IP_PNP_DHCP=y
CONFIG_IP_PNP_BOOTP=y
# CONFIG_INET_DIAG is not set
CONFIG_SYN_COOKIES=y
CONFIG_NETFILTER=y
CONFIG_NF_CONNTRACK=y
CONFIG_NF_NAT=y
CONFIG_IP_NF_IPTABLES=y
CONFIG_IP_NF_FILTER=y
CONFIG_IP_NF_TARGET_MASQUERADE=m
CONFIG_PCI=y
CONFIG_DEVTMPFS=y
CONFIG_DEVTMPFS_MOUNT=y
CONFIG_MTD=y
CONFIG_MTD_CMDLINE_PARTS=y
CONFIG_MTD_BLOCK=y
CONFIG_MTD_PHYSMAP=y
CONFIG_MTD_SPI_NOR=y
CONFIG_MTD_SPI_NOR_USE_4K_SECTORS=y
CONFIG_BLK_DEV_LOOP=y
CONFIG_BLK_DEV_RAM=y
CONFIG_BLK_DEV_RAM_SIZE=8192
CONFIG_ATA=y
CONFIG_ATA_PIIX=y
CONFIG_PATA_AMD=y
CONFIG_PATA_OLDPIIX=y
CONFIG_NETDEVICES=y
CONFIG_8139TOO=y
CONFIG_E100=y
CONFIG_INPUT_EVDEV=m
CONFIG_SERIAL_8250=y
CONFIG_SERIAL_8250_CONSOLE=y
CONFIG_SERIAL_8250_NR_UARTS=4
CONFIG_SERIAL_8250_EXTENDED=y
CONFIG_HW_RANDOM=y
CONFIG_I2C=y
CONFIG_I2C_CHARDEV=y
CONFIG_SPI=y
CONFIG_GPIOLIB=y
CONFIG_WATCHDOG=y
CONFIG_WATCHDOG_CORE=y
CONFIG_USB=y
CONFIG_USB_STORAGE=y
CONFIG_USB_UHCI_HCD=y
CONFIG_USB_EHCI_HCD=y
CONFIG_RTC_CLASS=y
CONFIG_RTC_HCTOSYS=y
CONFIG_EXT4_FS=y
CONFIG_SQUASHFS=y
CONFIG_SQUASHFS_XZ=y
CONFIG_TMPFS=y
CONFIG_VFAT_FS=y
CONFIG_JFFS2_FS=y
CONFIG_NFS_FS=y
CONFIG_ROOT_NFS=y
CONFIG_NLS_DEFAULT="utf8"
CONFIG_NLS_CODEPAGE_437=y
CONFIG_NLS_UTF8=y
CONFIG_PRINTK_TIME=y
CONFIG_MAGIC_SYSRQ=y
```

## arch/x86/configs/i386_legacy_defconfig
```kconfig
# Legacy 32-bit x86 — Linux32 fork
# copyright Koubba Mohamed Rayan — Chamesle-Certification-1.0
# Target: PII/PIII/P4/VIA era PCs, PATA, classic PCI NICs

CONFIG_WERROR=y
CONFIG_LOCALVERSION="-legacy"
CONFIG_LINUX32_EMBEDDED=y
CONFIG_SYSVIPC=y
CONFIG_NO_HZ_IDLE=y
CONFIG_HIGH_RES_TIMERS=y
CONFIG_PREEMPT_VOLUNTARY=y
CONFIG_LOG_BUF_SHIFT=15
CONFIG_BLK_DEV_INITRD=y
# CONFIG_64BIT is not set
CONFIG_SMP=y
CONFIG_HZ_250=y
CONFIG_MODULES=y
CONFIG_MODULE_UNLOAD=y
CONFIG_X86_MSR=y
CONFIG_X86_CPUID=y
CONFIG_X86_CHECK_BIOS_CORRUPTION=y
# CONFIG_EFI is not set
CONFIG_CPU_FREQ=y
CONFIG_CPU_FREQ_DEFAULT_GOV_ONDEMAND=y
CONFIG_X86_ACPI_CPUFREQ=y
CONFIG_NET=y
CONFIG_PACKET=y
CONFIG_UNIX=y
CONFIG_INET=y
CONFIG_IP_PNP=y
CONFIG_IP_PNP_DHCP=y
CONFIG_PCI=y
CONFIG_DEVTMPFS=y
CONFIG_DEVTMPFS_MOUNT=y
CONFIG_ATA=y
CONFIG_ATA_PIIX=y
CONFIG_PATA_AMD=y
CONFIG_PATA_OLDPIIX=y
CONFIG_PATA_MPIIX=y
CONFIG_FLOPPY=y
CONFIG_BLK_DEV_SD=y
CONFIG_BLK_DEV_SR=y
CONFIG_NETDEVICES=y
CONFIG_NE2000=y
CONFIG_NE2K_PCI=y
CONFIG_8139TOO=y
CONFIG_E100=y
CONFIG_PCNET32=y
CONFIG_SERIAL_8250=y
CONFIG_SERIAL_8250_CONSOLE=y
CONFIG_SERIAL_8250_NR_UARTS=4
CONFIG_VT=y
CONFIG_VT_CONSOLE=y
CONFIG_FRAMEBUFFER_CONSOLE=y
CONFIG_FB_VESA=y
CONFIG_USB=y
CONFIG_USB_UHCI_HCD=y
CONFIG_USB_EHCI_HCD=y
CONFIG_USB_OHCI_HCD=y
CONFIG_USB_STORAGE=y
CONFIG_EXT4_FS=y
CONFIG_VFAT_FS=y
CONFIG_ISO9660_FS=y
CONFIG_TMPFS=y
CONFIG_NLS_CODEPAGE_437=y
CONFIG_NLS_UTF8=y
CONFIG_MAGIC_SYSRQ=y
```

## arch/x86/configs/i386_server_defconfig
```kconfig
# 32-bit x86 server — Linux32 fork
# copyright Koubba Mohamed Rayan — Chamesle-Certification-1.0
# Target: SMP, PAE (>4 GB RAM), RAID, bonding, heavy storage/network

CONFIG_WERROR=y
CONFIG_LOCALVERSION="-server"
CONFIG_SYSVIPC=y
CONFIG_POSIX_MQUEUE=y
CONFIG_NO_HZ_IDLE=y
CONFIG_HIGH_RES_TIMERS=y
CONFIG_PREEMPT_NONE=y
CONFIG_LOG_BUF_SHIFT=18
CONFIG_CGROUPS=y
CONFIG_BLK_CGROUP=y
CONFIG_BLK_DEV_INITRD=y
# CONFIG_64BIT is not set
CONFIG_SMP=y
CONFIG_X86_BIGSMP=y
CONFIG_X86_PAE=y
CONFIG_HZ_250=y
CONFIG_KEXEC=y
CONFIG_MODULES=y
CONFIG_MODULE_UNLOAD=y
CONFIG_X86_MSR=y
CONFIG_X86_CPUID=y
CONFIG_EFI=y
CONFIG_EFI_STUB=y
CONFIG_CPU_FREQ=y
CONFIG_CPU_FREQ_DEFAULT_GOV_ONDEMAND=y
CONFIG_X86_ACPI_CPUFREQ=y
CONFIG_NET=y
CONFIG_PACKET=y
CONFIG_UNIX=y
CONFIG_XFRM_USER=y
CONFIG_INET=y
CONFIG_IP_MULTICAST=y
CONFIG_IP_ADVANCED_ROUTER=y
CONFIG_IP_MULTIPLE_TABLES=y
CONFIG_IP_PNP=y
CONFIG_IP_PNP_DHCP=y
CONFIG_SYN_COOKIES=y
CONFIG_NETFILTER=y
CONFIG_NF_CONNTRACK=y
CONFIG_NF_NAT=y
CONFIG_IP_NF_IPTABLES=y
CONFIG_BRIDGE=y
CONFIG_VLAN_8021Q=y
CONFIG_NET_SCHED=y
CONFIG_PCI=y
CONFIG_PCIEPORTBUS=y
CONFIG_PCI_MSI=y
CONFIG_DEVTMPFS=y
CONFIG_DEVTMPFS_MOUNT=y
CONFIG_MD=y
CONFIG_BLK_DEV_MD=y
CONFIG_BLK_DEV_DM=y
CONFIG_DM_RAID=y
CONFIG_DM_MIRROR=y
CONFIG_ATA=y
CONFIG_SATA_AHCI=y
CONFIG_ATA_PIIX=y
CONFIG_SCSI=y
CONFIG_BLK_DEV_SD=y
CONFIG_BLK_DEV_SR=y
CONFIG_NETDEVICES=y
CONFIG_BONDING=m
CONFIG_TIGON3=y
CONFIG_E1000=y
CONFIG_E1000E=y
CONFIG_8139TOO=y
CONFIG_SERIAL_8250=y
CONFIG_SERIAL_8250_CONSOLE=y
CONFIG_SERIAL_8250_NR_UARTS=32
CONFIG_HW_RANDOM=y
CONFIG_I2C=y
CONFIG_WATCHDOG=y
CONFIG_EXT4_FS=y
CONFIG_XFS_FS=y
CONFIG_QUOTA=y
CONFIG_NFS_FS=y
CONFIG_NFS_V4=y
CONFIG_TMPFS=y
CONFIG_NLS_UTF8=y
CONFIG_SECURITY=y
CONFIG_MAGIC_SYSRQ=y
```

## arch/x86/configs/i386_ultra_weak_defconfig
```kconfig
# Ultra-weak 32-bit x86 — Linux32 fork
# copyright Koubba Mohamed Rayan — Chamesle-Certification-1.0
# Target: 486+, 16–64 MB RAM, serial console, initramfs root

CONFIG_WERROR=y
CONFIG_LOCALVERSION="-ultra-weak"
CONFIG_LINUX32_EMBEDDED=y
CONFIG_CC_OPTIMIZE_FOR_SIZE=y
CONFIG_KERNEL_XZ=y
CONFIG_SYSVIPC=y
CONFIG_NO_HZ_IDLE=y
CONFIG_HZ_100=y
CONFIG_LOG_BUF_SHIFT=13
CONFIG_BLK_DEV_INITRD=y
# CONFIG_64BIT is not set
# CONFIG_SMP is not set
# CONFIG_MODULES is not set
# CONFIG_EFI is not set
# CONFIG_HIBERNATION is not set
# CONFIG_AUDIT is not set
# CONFIG_KALLSYMS is not set
CONFIG_SLUB=y
CONFIG_SLUB_TINY=y
CONFIG_LD_DEAD_CODE_DATA_ELIMINATION=y
CONFIG_X86_MSR=y
CONFIG_X86_CPUID=y
CONFIG_NET=y
CONFIG_INET=y
CONFIG_IP_PNP=y
CONFIG_IP_PNP_DHCP=y
CONFIG_DEVTMPFS=y
CONFIG_DEVTMPFS_MOUNT=y
CONFIG_BLK_DEV_RAM=y
CONFIG_BLK_DEV_RAM_SIZE=4096
CONFIG_SERIAL_8250=y
CONFIG_SERIAL_8250_CONSOLE=y
CONFIG_SERIAL_8250_NR_UARTS=2
CONFIG_EXT4_FS=y
CONFIG_SQUASHFS=y
CONFIG_SQUASHFS_XZ=y
CONFIG_TMPFS=y
CONFIG_PRINTK=y
CONFIG_MAGIC_SYSRQ=y
```
